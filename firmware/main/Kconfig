## firmware/main/Kconfig
```kconfig
menu "Cronus"
    menu "Display"
        choice CRONUS_DISPLAY_DRIVER
            prompt "Driver"
            default CRONUS_DISPLAY_DRIVER_MAX7219_32X16_ENABLED

            config CRONUS_DISPLAY_DRIVER_MAX7219_32X16_ENABLED
                bool "MAX7219 (32x16)"
        endchoice

        menu "MAX7219 Configuration"
            depends on CRONUS_DISPLAY_DRIVER_MAX7219_32X16_ENABLED

            config CRONUS_DISPLAY_DRIVER_MAX7219_32X16_PIN_CLK
                int "CLK pin"
                range 0 48
                default 16

            config CRONUS_DISPLAY_DRIVER_MAX7219_32X16_PIN_CS
                int "CS pin"
                range 0 48
                default 17

            config CRONUS_DISPLAY_DRIVER_MAX7219_32X16_PIN_DATA
                int "DATA pin"
                range 0 48
                default 18

            config CRONUS_DISPLAY_DRIVER_MAX7219_32X16_RX
                bool "Reverse X"
                default y

            config CRONUS_DISPLAY_DRIVER_MAX7219_32X16_RY
                bool "Reverse Y"
                default n
        endmenu

        config CRONUS_DISPLAY_INITIAL_BRIGHTNESS
            int "Initial brightness"
            range 0 15
            default 0
    endmenu

    menu "External RTC (DS3231)"
        config CRONUS_DS3231_ENABLED
            bool "Enabled"
            default y
        config CRONUS_DS3231_PIN_SCL
            depends on CRONUS_DS3231_ENABLED
            int "SCL pin"
            range 0 48
            default 39
        config CRONUS_DS3231_PIN_SDA
            depends on CRONUS_DS3231_ENABLED
            int "SDA pin"
            range 0 48
            default 38
    endmenu

    menu "Light sensor"
        config CRONUS_LIGHT_SENSOR_ENABLED
            bool "Enabled"
            default y
        config CRONUS_LIGHT_SENSOR_ADC_CHANNEL
            depends on CRONUS_LIGHT_SENSOR_ENABLED
            int "ADC channel"
            range 0 48
            default 0
    endmenu
endmenu
```

## main/Kconfig
```kconfig
menu "Cronus"
    menu "Display"
        choice CRONUS_DISPLAY_DRIVER
            prompt "Driver"
            default CRONUS_DISPLAY_DRIVER_MAX7219_ENABLED

            config CRONUS_DISPLAY_DRIVER_MAX7219_ENABLED
                bool "MAX7219"
        endchoice

        menu "MAX7219 Configuration"
            depends on CRONUS_DISPLAY_DRIVER_MAX7219_ENABLED

            config CRONUS_DISPLAY_DRIVER_MAX7219_ID
                int "Display ID"
                range 0 3
                default 0

            config CRONUS_DISPLAY_DRIVER_MAX7219_PIN_CS
                int "CS pin"
                range 0 48
                default 16

            config CRONUS_DISPLAY_DRIVER_MAX7219_PIN_CLK
                int "CLK pin"
                range 0 48
                default 17

            config CRONUS_DISPLAY_DRIVER_MAX7219_PIN_DATA
                int "DATA pin"
                range 0 48
                default 18

            config CRONUS_DISPLAY_DRIVER_MAX7219_NX
                int "Devices per X"
                range 1 8
                default 4

            config CRONUS_DISPLAY_DRIVER_MAX7219_NY
                int "Devices per Y"
                range 1 8
                default 1

            config CRONUS_DISPLAY_DRIVER_MAX7219_RX
                bool "Reverse X"
                default y

            config CRONUS_DISPLAY_DRIVER_MAX7219_RY
                bool "Reverse Y"
                default n
        endmenu

        config CRONUS_DISPLAY_INITIAL_BRIGHTNESS
            int "Initial brightness"
            range 0 15
            default 0
    endmenu

    menu "External RTC (DS3231)"
        config CRONUS_DS3231_ENABLED
            bool "Enabled"
            default y
        config CRONUS_DS3231_PIN_SCL
            depends on CRONUS_DS3231_ENABLED
            int "SCL pin"
            range 0 48
            default 38
        config CRONUS_DS3231_PIN_SDA
            depends on CRONUS_DS3231_ENABLED
            int "SDA pin"
            range 0 48
            default 39
    endmenu

    menu "Light sensor"
        config CRONUS_LIGHT_SENSOR_ENABLED
            bool "Enabled"
            default y
        config CRONUS_LIGHT_SENSOR_ADC_CHANNEL
            depends on CRONUS_LIGHT_SENSOR_ENABLED
            int "ADC channel"
            range 0 48
            default 0
    endmenu
endmenu
```

## src/main/Kconfig
```kconfig
menu "Cronus"
    menu "Display"
        choice CRONUS_DISPLAY_DRIVER
            prompt "Driver"
            default CRONUS_DISPLAY_0_DRIVER_MAX7219_32X16

            config CRONUS_DISPLAY_0_DRIVER_MAX7219_32X16
                bool "MAX7219 (32x16)"
            config CRONUS_DISPLAY_0_DRIVER_WS2812_32X16
                bool "WS2812 (32x16)"
        endchoice

        config CRONUS_DISPLAY_0_DRIVER_MAX7219_32X16_PIN_CLK
            depends on CRONUS_DISPLAY_0_DRIVER_MAX7219_32X16
            int "CLK pin"
            range 0 48
            default 16

        config CRONUS_DISPLAY_0_DRIVER_MAX7219_32X16_PIN_CS
            depends on CRONUS_DISPLAY_0_DRIVER_MAX7219_32X16
            int "CS pin"
            range 0 48
            default 17

        config CRONUS_DISPLAY_0_DRIVER_MAX7219_32X16_PIN_DATA
            depends on CRONUS_DISPLAY_0_DRIVER_MAX7219_32X16
            int "DATA pin"
            range 0 48
            default 18

        config CRONUS_DISPLAY_0_DRIVER_WS2812_32X16_PIN_DATA
            depends on CRONUS_DISPLAY_0_DRIVER_WS2812_32X16
            int "DATA pin"
            range 0 48
            default 18
    endmenu

    menu "External RTC (DS3231)"
        config CRONUS_DS3231_ENABLED
            bool "Enabled"
            default y
        config CRONUS_DS3231_PIN_SDA
            depends on CRONUS_DS3231_ENABLED
            int "SDA pin"
            range 0 48
            default 38
        config CRONUS_DS3231_PIN_SCL
            depends on CRONUS_DS3231_ENABLED
            int "SCL pin"
            range 0 48
            default 39
    endmenu

    menu "Light sensor"
        config CRONUS_LIGHT_SENSOR_ENABLED
            bool "Enabled"
            default y
        config CRONUS_LIGHT_SENSOR_ADC_CHANNEL
            depends on CRONUS_LIGHT_SENSOR_ENABLED
            int "ADC channel"
            range 0 48
            default 0
    endmenu
endmenu
```
